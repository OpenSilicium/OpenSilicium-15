## RTnet_exemples/APF6/patches/Kconfig.patch
```kconfig
--- xenomai-3.0-rc4.old/kernel/drivers/net/drivers/Kconfig	2015-02-18 10:12:00.000000000 +0100
+++ xenomai-3.0-rc4/kernel/drivers/net/drivers/Kconfig	2015-04-02 10:22:15.563187844 +0200
@@ -4,6 +4,11 @@
 comment "Common PCI Drivers"
     depends on PCI
 
+config XENO_DRIVERS_NET_DRV_FEC
+    depends on XENO_DRIVERS_NET
+    tristate "I.MX6 FEC Ethernet"
+
+
 config XENO_DRIVERS_NET_DRV_PCNET32
     depends on XENO_DRIVERS_NET && PCI
     tristate "AMD PCnet32"
```

## RTnet_exemples/configs/BR/configs/bbb_xeno_rtnet_defconfig
```kconfig
BR2_arm=y
BR2_cortex_a8=y
BR2_ARM_FPU_VFPV2=y
BR2_TOOLCHAIN_EXTERNAL=y
BR2_TOOLCHAIN_EXTERNAL_CODESOURCERY_ARM201305=y
BR2_TARGET_GENERIC_HOSTNAME="bbb"
BR2_TARGET_GENERIC_ISSUE="Welcome to Buildroot (Xenomai/RTnet)"
BR2_ROOTFS_DEVICE_CREATION_DYNAMIC_EUDEV=y
BR2_TARGET_GENERIC_GETTY_PORT="ttyAMA0"
BR2_ROOTFS_OVERLAY="board/beaglebone/overlay"
BR2_LINUX_KERNEL=y
BR2_LINUX_KERNEL_CUSTOM_GIT=y
BR2_LINUX_KERNEL_CUSTOM_REPO_URL="https://github.com/beagleboard/linux"
BR2_LINUX_KERNEL_CUSTOM_REPO_VERSION="3.8.13-bone67"
BR2_LINUX_KERNEL_USE_CUSTOM_CONFIG=y
BR2_LINUX_KERNEL_CUSTOM_CONFIG_FILE="board/beaglebone/3.8.13/xeno_no_eth.config"
BR2_LINUX_KERNEL_ZIMAGE=y
BR2_LINUX_KERNEL_DTS_SUPPORT=y
BR2_LINUX_KERNEL_INTREE_DTS_NAME="am335x-boneblack"
BR2_LINUX_KERNEL_EXT_XENOMAI=y
BR2_LINUX_KERNEL_EXT_XENOMAI_ADEOS_PATCH="board/beaglebone/3.8.13/ipipe-core-3.8.13-arm-3_BBB.patch"
BR2_PACKAGE_BUSYBOX_CONFIG="board/beaglebone/3.8.13/busybox.config"
BR2_PACKAGE_RT_TESTS=y
BR2_PACKAGE_STRACE=y
BR2_PACKAGE_STRESS=y
BR2_PACKAGE_EVTEST=y
BR2_PACKAGE_KBD=y
BR2_PACKAGE_LIBCOFI=y
BR2_PACKAGE_PCRE=y
BR2_PACKAGE_PCRE_16=y
BR2_PACKAGE_DROPBEAR=y
BR2_PACKAGE_TCPDUMP=y
BR2_PACKAGE_XENOMAI_TESTSUITE=y
BR2_TARGET_ROOTFS_TAR_GZIP=y
BR2_PACKAGE_HOST_E2FSPROGS=y
BR2_PACKAGE_HOST_GENEXT2FS=y
```

## RTnet_exemples/pkg/package/rtnet/Config.in
```kconfig
config BR2_PACKAGE_RTNET
	bool "RTnet"
	depends on BR2_LINUX_KERNEL
	depends on BR2_PACKAGE_XENOMAI
	depends on BR2_LINUX_KERNEL_EXT_XENOMAI
	help
	  Kernel modules for the RTnet Hard Real-Time Networking stack 
	  for Real-Time Linux.

	  http://www.rtnet.org

comment "rtnet requires time linux kernel to be built"
	depends on !BR2_LINUX_KERNEL

comment "rtnet requires a xenomai real-time linux kernel to be built"
	depends on !BR2_LINUX_KERNEL_EXT_XENOMAI

comment "rtnet requires xenomai to be built"
	depends on !BR2_PACKAGE_XENOMAI
```
